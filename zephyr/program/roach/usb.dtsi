/* Copyright 2023 The ChromiumOS Authors
 * Use of this source code is governed by a BSD-style license that can be
 * found in the LICENSE file.
 */

&usb0 {
	status = "okay";
	pinctrl-0 = <&usb0_dm_gph5_default
		     &usb0_dp_gph6_default>;
	pinctrl-names = "default";
};

