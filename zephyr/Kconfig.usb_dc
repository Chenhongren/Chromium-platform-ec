## zephyr/Kconfig.usb_dc
```kconfig
# Copyright 2023 The ChromiumOS Authors
# Use of this source code is governed by a BSD-style license that can be
# found in the LICENSE file.

config PLATFORM_EC_USB_HID_KEYBOARD
	bool "USB HID keyboard interface"
	help
	  Support USB HID keyboard interface

config PLATFORM_EC_USB_HID_TOUCHPAD
	bool "USB HID touchpad interface"
	help
	  Support USB HID touchpad interface
```

## zephyr/Kconfig.usb_update
```kconfig
config PLATFORM_EC_TOUCHPAD_HASH_FW
	bool "Include hashes of the touchpad FW in the EC image"
	depends on PLATFORM_EC_TOUCHPAD
	help
	  Include hashes of the touchpad FW in the EC image.

	  User can provide the firmware image by passing a TOUCHPAD_FW parameter
	  to the make command, e.g. `zmake build -DTOUCHPAD_FW=/path/to/fw ...`.

if PLATFORM_EC_TOUCHPAD_HASH_FW

config PLATFORM_EC_TOUCHPAD_VIRTUAL_OFF
	hex "Touchpad virtual offset"
	help
	  Touchpad virtual address for the USB update protocol.

config PLATFORM_EC_TOUCHPAD_VIRTUAL_SIZE
	int "Touchpad virtual size"
	help
	  Touchpad virtual size for the USB update protocol, must equal to the
	  size of TOUCHPAD_FW if provided.

endif # PLATFORM_EC_TOUCHPAD_HASH_FW

config PLATFORM_EC_UPDATE_PDU_SIZE
	int "PDU size for firmware update over USB or TPM"
	help
	  Size of the update protocol data units (PDU).

	  See docs/usb_updater.md.
```

## zephyr/drivers/cros_one_wire_uart/Kconfig
```kconfig
# Copyright 2023 The ChromiumOS Authors
# Use of this source code is governed by a BSD-style license that can be
# found in the LICENSE file.

config PLATFORM_EC_ONE_WIRE_UART
	bool ""
	depends on DT_HAS_CROS_EC_ONE_WIRE_UART_ENABLED
	default y
	help
	  <WIP>
```

## zephyr/dts/bindings/cros_one_wire_uart/cros-ec,one-wire-uart.yaml
```yaml
# Copyright 2022 The ChromiumOS Authors
# Use of this source code is governed by a BSD-style license that can be
# found in the LICENSE file.

description: WIP

compatible: "cros-ec,one-wire-uart"

include: base.yaml

properties:
  id:
    type: int
    required: true
    description: |
      <WIP>
```

## zephyr/subsys/usb_dc/Kconfig
```kconfig
# Copyright 2023 The ChromiumOS Authors
# Use of this source code is governed by a BSD-style license that can be
# found in the LICENSE file.

config PLATFORM_EC_USB_HID_KEYBOARD
	bool "Enable support USB HID keyboard"
	default n
	help
	  Enable keyboard support.

config PLATFORM_EC_HID_VIVALDI
	bool "Enable support vivaldi keyboard"
	depends on PLATFORM_EC_USB_HID_KEYBOARD
	default n
	help
	  Enable code for Vivaldi keyboard (standard for new Chromium OS
	  devices).

config PLATFORM_EC_KEYBOARD_ASSISTANT_KEY
	bool "Enable support USB HID touchpad"
	depends on PLATFORM_EC_USB_HID_KEYBOARD
	default n
	help
	  Enable assistant key for keyboard device.

config PLATFORM_EC_KEYBOARD_TABLET_MODE_SWITCH
	bool "Enable support USB HID touchpad"
	depends on PLATFORM_EC_USB_HID_KEYBOARD
	default n
	help
	  Enable tablet mode switch for keyboard device.

config PLATFORM_EC_KEYBOARD_NUM_TOP_ROW_KEYS
	int "Enable support vivaldi keyboard"
	default 10
	help
	  The number of top raw keys. The number should be within 10 to 15.

config PLATFORM_EC_USB_HID_TOUCHPAD
	bool "Enable support USB HID touchpad"
	default n
	help
	  Enable touchpad support.
```
